;*********************************************************************
;*	Oregon State University
;*	ST7565R LCD Driver
;*	This code configures the graphical LCD and emulates
;*	the behavior of a 2x16 character display.
;*
;*	The LCD has room for 32 characters in total
;*	(16 on the top and 16 on the bottom).
;*	The upper 16 characters should be located in SRAM starting at 0x0100.
;*	The lower 16 characters should be located in SRAM starting at 0x0110.
;*
;*	NOTE: Register r16 MUST be named 'mpr' in the Main Code
;*	Something like this:
;*	.def	mpr = r16
;*
;*	WARNING: Register r20-r22 are reserved and cannot be
;*		renamed outside of the LCD Driver functions. Doing
;*		so will damage the functionality of the LCD Driver
;*
;*	Acknowledgements: the Bin2ASCII and div10 procedures were written by
;*	David Zier for a previous board. The code has been retained intact.
;*
;*********************************************************************
;*	Rev	Date		Name			Description
;*--------------------------------------------------------------------
;*	-	8/18/22	Justin Goins	Version 1.0
;*
;*
;*********************************************************************

.include "m32U4def.inc"				; Include definition file

; Register definitions
.def	count = r20			; Character Counter
.def	q = r21			; Quotient for div10
.def	r = r22			; Remander for div10

; The following constants are not intended to be modified.
.equ	lcd_buffer_addr = 0x0100 ; define the SRAM base address of the LCD buffer

; This information is gathered from the ST7565R datasheet.
; define some command patterns
.equ	lcd_c_disp_en = 0b10101110 ; lsb indicates whether the LCD is on (1) or off (0)
.equ	lcd_c_disp_set_start_ln = 0b01000000 ; lower 6 bits indicate the line index (0 - 63)
.equ	lcd_c_disp_set_page_addr = 0b10110000 ; lower 4 bits indicate the page address (page 3 is at top and page 0 is at bottom)
; together, these commands allow you to specify a column index from (0 - 131):
.equ	lcd_c_disp_set_col_addr_h = 0b00010000 ; lower 4 bits indicate the 4 high bits of the column address
.equ	lcd_c_disp_set_col_addr_l = 0b00000000 ; lower 4 bits indicate the 4 low bits of the column address
.equ	lcd_c_disp_set_invert = 0b10100110 ; lsb indicates whether the LCD is normal (0) or inverted (1)
.equ	lcd_c_disp_fill = 0b10100100 ; lsb indicates whether the LCD is normal (0) or filled with dots (1)
.equ	lcd_c_disp_reset = 0b11100010 ; resets the line/page addresses and other stuff, does not affect data RAM
.equ	lcd_c_disp_set_bias = 0xA2 ; 1/6 bias (in 1/33 duty mode)
.equ	lcd_c_disp_set_scandir = 0b11000000 ; select normal scan direction (most significant bit is placed at top of LCD)
.equ	lcd_c_disp_set_contrast_1 = 0b10000001 ; first we send this command then we pass the value
.equ	lcd_c_disp_set_contrast_2 = 15 ; can select a contrast value between 1 and 63
.equ	lcd_c_disp_set_res_ratio = 0x22 ; see the datasheet
.equ	lcd_c_disp_vreg_on = 0x2F ; enable voltage booster, voltage regulator, and voltage follower

; use this command to write into the LCD RAM:
.equ	lcd_c_disp_write = 0b00000000 ; these 8 bits are the data to be placed in the target. 
; note that the column address is automatically incremented by 1 after each write to the LCD data

; everything in this driver file needs to go into the code segment
.cseg

;*****************************************************************
;* Func:	LCDInit
;* Desc:	This function initializes the LCD control pins and
;*		sets reasonable values for the configuration registers.
;*****************************************************************
LCDInit:
	push	mpr

	; set MOSI, SCL, and SS as outputs
	sbi	DDRB, DDB2	; Port B 2
	sbi	DDRB, DDB1	; Port B 1
	sbi	DDRB, DDB0	; Port B 0
	; ensure that SS is deactivated (active low)
	sbi	PORTB, 0
	; set lcd_A0 as output
	sbi	DDRF, DDF1	; Port F 1
	; enable LCD backlight control
	sbi	DDRC, DDC7	; Port C 7
	; set lcd_RST_N as output
	sbi	DDRF, DDF0	; Port F 0
	; we pull lcd_RST_N low for 1 millisecond
	cbi	PORTF, 0
	call	LCDDelay
	sbi	PORTF, 0
	; Enable SPI mode 3, master configuration, set clock rate fck/2 using SPI2X
	ldi	mpr, (1<<SPE)|(1<<MSTR)|(1<<CPOL)|(1<<CPHA)
	out	SPCR, mpr
	ldi	mpr, (1<<SPI2X)
	out	SPSR, mpr
	; Note: after transmitting a byte, the SPI interrupt flag will
	; be automatically cleared next time we: 1) read SPSR and ALSO 2) access SPDR

	cbi	PORTB, 0	; activate slave select
	; send a string of initialization commands
	ldi	mpr, lcd_c_disp_set_bias
	rcall	LCD_Internal_WriteCMD
	ldi	mpr, lcd_c_disp_set_scandir
	rcall	LCD_Internal_WriteCMD
	ldi	mpr, lcd_c_disp_set_contrast_1
	rcall	LCD_Internal_WriteCMD
	ldi	mpr, lcd_c_disp_set_contrast_2
	rcall	LCD_Internal_WriteCMD
	ldi	mpr, lcd_c_disp_set_res_ratio
	rcall	LCD_Internal_WriteCMD
	ldi	mpr, lcd_c_disp_vreg_on
	rcall	LCD_Internal_WriteCMD
	ldi	mpr, (lcd_c_disp_en | 1 << 0)
	rcall	LCD_Internal_WriteCMD
	sbi	PORTB, 0	; deactivate slave select

	pop	mpr
	ret

;*****************************************************************
;* Func:	LCDBacklightOn
;* Desc:	Enables the backlight
;*****************************************************************
LCDBacklightOn:
	sbi	PORTC, 7
	ret

;*****************************************************************
;* Func:	LCDBacklightOff
;* Desc:	Disables the backlight
;*****************************************************************
LCDBacklightOff:
	cbi	PORTC, 7
	ret

;*****************************************************************
;* Func:	LCDWrite
;* Desc:	This function writes 32 characters to the LCD screen...
;*		16 chars on the top line and 16 chars on the bottom line.
;*****************************************************************
LCDWrite:
	rcall	LCDWrLn1
	rcall	LCDWrLn2
	ret

;*****************************************************************
;* Func:	LCDWrLn1
;* Desc:	This function writes 16 characters to the top line.
;*****************************************************************
LCDWrLn1:
	push	XH
	push	XL
	push	r17
	; r17 specifies the destination bank in LCD RAM
	ldi	r17, 3
	; point X at the ASCII data
	ldi	XH, HIGH(lcd_buffer_addr)
	ldi	XL, LOW(lcd_buffer_addr)
	rcall	LCD_Internal_WriteLn
	pop	r17
	pop	XL
	pop	XH
	ret

;*****************************************************************
;* Func:	LCDWrLn2
;* Desc:	This function writes 16 characters to the bottom line.
;*****************************************************************
LCDWrLn2:
	push	XH
	push	XL
	push	r17
	; r17 specifies the destination bank in LCD RAM
	ldi	r17, 1
	; point X at the ASCII data
	ldi	XH, HIGH(lcd_buffer_addr+16)
	ldi	XL, LOW(lcd_buffer_addr+16)
	rcall	LCD_Internal_WriteLn
	pop	r17
	pop	XL
	pop	XH
	ret

;*****************************************************************
;* Func:	LCDClr
;* Desc:	This function clears the entire LCD screen.
;*****************************************************************
LCDClr:
	rcall	LCDClrLn1
	rcall	LCDClrLn2

	ret

;*****************************************************************
;* Func:	CLRDM1
;* Desc:	This function clears Data Memory by writing 16 
;*		consecutive ASCII spaces $20 to the memory at $0100.
;*****************************************************************
CLRDM1:
    ; Set X register points to $0100
	   push	   XH
	   PUSH	   XL
           push    r16
           push    r17

           ldi     XH, HIGH(lcd_buffer_addr)
           ldi     XL, LOW(lcd_buffer_addr)
           ldi     r17, 16
           ldi     r16, ' '
   CLRloop1:
           st      X+, r16         ; load data to DM
           dec     r17
           brne    CLRloop1

	   pop	   r17
	   pop	   r16
	   pop	   XL
	   pop	   XH

           ret

;*****************************************************************
;* Func:	CLRDM2
;* Desc:	This function clears Data Memory by writing 16 
;*		consecutive ASCII spaces $20 to the memory at $0110.
;*****************************************************************
CLRDM2:
    ; Set X register points to $0110
	   push	   XH
	   PUSH	   XL
           push    r16
           push    r17

           ldi     XH, HIGH(lcd_buffer_addr+16)
           ldi     XL, LOW(lcd_buffer_addr+16)
           ldi     r17, 16
           ldi     r16, ' '
   CLRloop2:
           st      X+, r16         ; load data to DM
           dec     r17
           brne    CLRloop2

	   pop	   r17
	   pop	   r16
	   pop	   XL
	   pop	   XH

           ret
;*****************************************************************
;* Func:	LCDClrLn1
;* Desc:	This function clears the top line of the LCD screen.
;*****************************************************************
LCDClrLn1:
	push	r17
	; r17 specifies the target bank in LCD RAM
	ldi	r17, 3
	rcall	LCD_Internal_ClearLn
	rcall	CLRDM1
	pop	r17
	ret

;*****************************************************************
;* Func:	LCDClrLn2
;* Desc:	This function clears the bottom line of the LCD screen.
;*****************************************************************
LCDClrLn2:
	push	r17
	; r17 specifies the target bank in LCD RAM
	ldi	r17, 1
	rcall	LCD_Internal_ClearLn
	rcall	CLRDM2
	pop	r17
	ret

;*****************************************************************
;* Func:	Bin2ASCII
;* Desc:	Converts a binary number into an ASCII 
;*			text string equivalent. 
;*			- The binary number needs to be in the mpr
;*			- The Start Address of where the text will
;*			 	be placed needs to be in the X Register
;*			- The count of the characters created are 
;*				added to the count register
;*****************************************************************
Bin2ASCII:
	push	mpr			; save mpr
	push	r			; save r
	push	q			; save q
	push	XH			; save X-pointer
	push	XL			;

	; Determine the range of mpr
	cpi	mpr, 100		; is mpr >= 100
	brlo	B2A_1			; goto next check
	ldi	count, 3		; Three chars are written
	adiw	XL, 3			; Increment X 3 address spaces
	rjmp	B2A_3			; Continue with program
B2A_1:
	cpi	mpr, 10		; is mpr >= 10
	brlo	B2A_2			; Continue with program
	ldi	count, 2		; Two chars are written
	adiw	XL, 2			; Increment X 2 address spaces
	rjmp	B2A_3			; Continue with program
B2A_2:
	adiw	XL, 1			; Increment X 1 address space
	ldi	count, 1		; One char is written

B2A_3:
	; Do-While statement that converts Binary to ASCII
	rcall	div10			; Call the div10 function
	ldi	mpr, '0'		; Set the base ASCII integer value
	add	mpr, r		; Create the ASCII integer value
	st	-X, mpr		; Load ASCII value to memory
	mov	mpr, q		; Set mpr to quotient value
	cpi	mpr, 0		; does mpr == 0
	brne	B2A_3			; do while (mpr != 0)

	pop	XL			; restore X-pointer
	pop	XH			;
	pop	q			; restore q
	pop	r			; restore r
	pop	mpr			; restore mpr
	ret				; return from function

;*****************************************************************
;*	The functions below here are intended for internal use only.
;*****************************************************************

;*****************************************************************
;* Func:	LCD_Internal_WriteLn
;* Desc:	Sends 16 characters of information to the LCD panel
;*		This is slightly more complicated than it sounds because the
;*		characters straddle two banks of the LCD memory.
;*		X is pointing at the first ASCII character to be displayed.
;*		r17 holds the index of the destination bank in LCD RAM.
;*		
;*****************************************************************
LCD_Internal_WriteLn:
	push	r0
	push	r1
	push	mpr
	push	r18
	push	r19
	push	r24
	push	r25
	push	ZL
	push	ZH

	; r25:24 holds a pointer to the base address of the bitmap array
	ldi	r25, HIGH(FontBitmap << 1);
	ldi	r24, LOW(FontBitmap << 1);

	cbi	PORTB, 0	; activate slave select

	; use a counter to track if we are on the top chunk or bottom chunk of each char
	ldi	r18, 2

LCD_WL_display_bank:
	; set the column to 0
	ldi	mpr, lcd_c_disp_set_col_addr_h
	rcall	LCD_Internal_WriteCMD
	ldi	mpr, lcd_c_disp_set_col_addr_l
	rcall	LCD_Internal_WriteCMD
	; we need to select the appropriate page
	ldi	mpr, lcd_c_disp_set_page_addr
	or	mpr, r17	; set the lower 4 bits
	rcall	LCD_Internal_WriteCMD

	ldi	r19, 16	; there are 16 characters per line

LCD_WL_next_char:
	; get ascii code point & determine location of corresponding character bitmap
	ld	r0, X+	; this should be a value from 0 to 255
	ldi	mpr, 16	; there are 16 bytes per character
	mul	r0, mpr	; determine the byte offset for the desired char
	movw	ZH:ZL, r25:r24	; copy the base address to Z
	add	ZL, r0	; finally, compute a pointer to the char bitmap
	adc	ZH, r1

	ldi	mpr, 8	; there are 8 columns for each character

	; this is where we display the chunk of character (either a top chunk or bottom chunk)
	lpm	r0, Z
LCD_WL_next_col:
	out	SPDR, r0
	sbi	PORTF, 1	; set lcd_A0 to specify data mode
	adiw	ZH:ZL, 2	; point Z at the next column for this bank
	lpm	r0, Z		; this is a sneaky way to save a few clock cycles (since we are waiting for the SPI communication)
LCD_WL_wait_spi:
	in	r1, SPSR
	sbrs	r1, SPIF	; wait for SPI to finish
	rjmp	LCD_WL_wait_spi

	; keep going until we have displayed all the columns for this character
	dec	mpr
	brne	LCD_WL_next_col

	; move to the next character
	dec	r19
	brne	LCD_WL_next_char

	; if we are at the end of the line, configure the bank and starting array offset for the bottom half of each char
	dec	r18		; did we display both banks yet?
	breq	LCD_WL_all_done
	; if not, then prepare to display the bottom chunk of each character
	dec	r17		; decrement the bank number
	sbiw	XH:XL, 16	; X needs to point back at the beginning character of the line
	adiw	r25:r24, 1	; increment the base address pointer (now it will point to the second chunk of each char)
	rjmp	LCD_WL_display_bank

LCD_WL_all_done:
	sbi	PORTB, 0	; deactivate slave select

	pop	ZH
	pop	ZL
	pop	r25
	pop	r24
	pop	r19
	pop	r18
	pop	mpr
	pop	r1
	pop	r0
	ret

;*****************************************************************
;* Func:	LCD_Internal_ClearLn
;* Desc:	This function clears two of the LCD memory banks.
;*		r17 specifies the starting bank to wipe.
;*****************************************************************
LCD_Internal_ClearLn:
	push	mpr
	push	r1
	push	r18
	push	r19

	cbi	PORTB, 0	; activate slave select
	ldi	r19, 2	; we are going to clear two banks

LCD_CLRLN_clear_bank:
	; set the column to 0
	ldi	mpr, lcd_c_disp_set_col_addr_h
	rcall	LCD_Internal_WriteCMD
	ldi	mpr, lcd_c_disp_set_col_addr_l
	rcall	LCD_Internal_WriteCMD
	; we need to select the appropriate page
	ldi	mpr, lcd_c_disp_set_page_addr
	or	mpr, r17	; configure the lower 4 bits
	rcall	LCD_Internal_WriteCMD

	ldi	r18, 128	; there are 128 columns on the LCD
	clr	mpr		; we will fill each column with empty dots (i.e. blank space)
	sbi	PORTF, 1	; set lcd_A0 to specify data mode

LCD_CLRLN_write_col:
	out	SPDR, mpr	; send an empty column to the LCD via SPI
LCD_CLRLN_wait_spi:
	in	r1, SPSR
	sbrs	r1, SPIF	; wait for SPI to finish
	rjmp	LCD_CLRLN_wait_spi

	dec	r18
	brne	LCD_CLRLN_write_col	; cycle through all 128 columns

	; clear the remaining bank if we haven't done so already
	dec	r19
	breq	LCD_CLRLN_all_done
	dec	r17		; decrement the bank index
	rjmp	LCD_CLRLN_clear_bank

LCD_CLRLN_all_done:
	sbi	PORTB, 0	; deactivate slave select	
	
	; pop registers...
	pop	r19
	pop	r18
	pop	r1
	pop	mpr
	ret

;*****************************************************************
;* Func:	LCD_Internal_WriteCMD
;* Desc:	Sends the byte in mpr
;*		If you use this function directly,
;*		YOU ARE RESPONSIBLE for handling the slave select line!
;*****************************************************************
LCD_Internal_WriteCMD:
	out	SPDR, mpr	; initiate transmission
	cbi	PORTF, 1	; clear lcd_A0 to put the lcd into command mode
				; (this just has to be done before the 8th bit
				; is transmitted via SPI)
LCD_IWC_L1:
	in	mpr, SPSR
	sbrs	mpr, SPIF	; wait for SPI to finish
	rjmp LCD_IWC_L1
	ret

;*****************************************************************
;* Func:	LCDDelay
;* Desc:	A wait loop that will consume roughly 1ms
;*		Note that a CALL takes 4 cycles on top of this delay.
;*****************************************************************
LCDDelay:
	push	mpr		; 2 cycles
	push	r17		; 2 cycles
	ldi	r17, 11	; 1 cycle
LCDDelay_L1:
	ldi	mpr, 242	; 1 cycle
LCDDelay_L2:
	dec	mpr		; 1 cycle
	brne	LCDDelay_L2	; 2 cycles on branch, 1 if no branch
	dec	r17		; 1 cycle
	brne	LCDDelay_L1	; 2 cycles on branch, 1 if no branch
	pop	r17		; 2 cycles
	pop	mpr		; 2 cycles
	ret			; 4 cycles

;*****************************************************************
;* Func:	div10
;* Desc:	Divides the value in the mpr by 10 and 
;*			puts the remainder in the 'r' register
;*			and the quotient in the 'q' register.
;*	DO NOT modify this function, trust me, it does
;*	divide by 10 :)  ~DZ		
;*****************************************************************
div10:
	push	r0		; Save register

	; q = mpr / 10 = mpr * 0.000110011001101b
	mov	q, mpr	; q = mpr * 1.0b
	lsr	q		; q >> 2
	lsr	q		; q = mpr * 0.01b
	add	q, mpr	; q = (q + mpr) >> 1
	lsr	q		; q = mpr * 0.101b
	add	q, mpr	; q = (q + mpr) >> 3
	lsr	q
	lsr	q
	lsr	q		; q = mpr * 0.001101b
	add	q, mpr	; q = (q + mpr) >> 1
	lsr	q		; q = mpr * 0.1001101b
	add	q, mpr	; q = (q + mpr) >> 3
	lsr	q				
	lsr	q
	lsr	q		; q = mpr * 0.0011001101b
	add	q, mpr	; q = (q + mpr) >> 1
	lsr	q		; q = mpr * 0.10011001101b
	add	q, mpr	; q = (q + mpr) >> 4
	lsr	q
	lsr	q
	lsr	q
	lsr	q		; q = mpr * 0.000110011001101b

	; compute the remainder as r = i - 10 * q
	; calculate r = q * 10 = q * 1010b
	mov	r, q		; r = q * 1
	lsl	r		; r << 2
	lsl	r		; r = q * 100b
	add	r, q		; r = (r + q) << 1
	lsl	r		; r = q * 1010b
	mov	r0, r		; r0 = 10 * q
	mov	r, mpr	; r = mpr
	sub	r, r0		; r = mpr - 10 * q

	; Fix any errors that occur
div10_1:
	cpi	r, 10		; Compare with 10
	brlo	div10_2	; do nothing if r < 10
	inc	q		; fix quotient
	subi	r, 10		; fix remainder
	rjmp	div10_1	; Continue until error is corrected

div10_2:
	pop	r0		; Restore registers
	ret			; Return from function

;*********************************************************************
;*	Bitmap Font Information
;*	Adapted into assembly code by Justin Goins.
;*	You can edit characters or add symbols if you choose (by modifying the data below)
;*	Each character is represented as a 8 x 16 pattern of dots (8 dots wide and 16 dots high).
;*	This implies that 16 bytes are allocated to represent each character.
;*
;*	The character information is arranged so that each line below equates to a single character.
;*	The first line is ASCII character 0, the next line is ASCII character 1,
;*	the next line is ASCII character 2, and so on.
;*	You can assign characters to any index within the extended ASCII range (0 to 255).
;*	With a bit of experimentation it's possible to define and display emojis (or any other graphical output).
;*	Be creative and have fun!
;*
;*	From original license file:
;*	Copyright 2011 Suraj N. Kurapati <https://github.com/sunaku/tamzen-font>
;*	Tamzen font is free.  You are hereby granted permission to use, copy, modify, and distribute it as you see fit.
;*	Tamzen font is provided "as is" without any express or implied warranty.
;*********************************************************************
FontBitmap:
.DB	0x00, 0x00, 0x0F, 0xF0, 0x08, 0x10, 0x08, 0x10, 0x08, 0x10, 0x08, 0x10, 0x0F, 0xF0, 0x00, 0x00	; U+0000
.DB	0x03, 0xFE, 0x7F, 0xFA, 0x83, 0xF6, 0x83, 0xEA, 0x83, 0xD6, 0x83, 0xAA, 0x7F, 0x56, 0x03, 0xFE	; U+E0A2
.DB	0x55, 0x54, 0xAA, 0xAA, 0x55, 0x54, 0xAA, 0xAA, 0x55, 0x54, 0xAA, 0xAA, 0x55, 0x54, 0xAA, 0xAA	; U+2592
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.DB	0x00, 0x00, 0x03, 0xE0, 0x18, 0x12, 0x00, 0x12, 0x00, 0x12, 0x18, 0x12, 0x03, 0xFC, 0x00, 0x00	; U+00FF


